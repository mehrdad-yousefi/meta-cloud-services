## meta-openstack/conf/layer.conf
```bitbake
# We have a conf and classes directory, append to BBPATH
BBPATH .= ":${LAYERDIR}"

# We have a recipes directory, add to BBFILES
BBFILES += "${LAYERDIR}/recipes*/*/*.bb ${LAYERDIR}/recipes*/*/*.bbappend"

BBFILE_COLLECTIONS += "openstack-layer"
BBFILE_PATTERN_openstack-layer := "^${LAYERDIR}/"
BBFILE_PRIORITY_openstack-layer = "5"
LAYERSERIES_COMPAT_openstack-layer = "thud warrior zeus"
BB_DANGLINGAPPENDS_WARNONLY ?= "true"

LAYERDEPENDS_openstack-layer = " \
	core \
        cloud-services-layer \
	openembedded-layer \
	networking-layer \
	filesystems-layer \
	webserver \
	meta-python \
	virtualization-layer \
	"

# pre 0.4.0 greenlet versions segfault python
PREFERRED_VERSION_python-greenlet = "0.4.5"
PREFERRED_VERSION_python-sqlalchemy = "1.0.8"
PREFERRED_VERSION_python-pexpect = "3.3"
PREFERRED_VERSION_python-django = "1.8.6"
PREFERRED_VERSION_python-netaddr = "0.7.19"
PREFERRED_VERSION_python-sqlalchemy = "1.0.16"
PREFERRED_VERSION_python-eventlet = "0.20.0"
PREFERRED_VERSION_python-warlock = "1.2.0"
PREFERRED_VERSION_python-jsonschema = "2.6.0"
PREFERRED_VERSION_python-networkx = "${@bb.utils.contains('DISTRO_FEATURES', 'openstack', '1.11', '', d)}"
PREFERRED_VERSION_python-oslo.i18n = "3.17.0+gitAUTOINC+f2729cd36f"

# Sanity check for meta-openstack layer.
# Setting SKIP_META_OPENSTACK_SANITY_CHECK to "1" would skip the bbappend files check.
INHERIT += "sanity-meta-openstack"

LICENSE_PATH += "${LAYERDIR}/licenses"
```
